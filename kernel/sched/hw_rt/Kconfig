## kernel/sched/hw_rt/Kconfig
```kconfig
menu "HUAWEI RT Capacity Aware"

config HW_RT_CAS
	bool "HW RT Capacity Aware RQ Selection"
	default y
	help
	  RT tasks detects capacity when CPU selection.

config HW_RT_ACTIVE_LB
	bool "HW RT Capacity Aware Misfit Task"
	depends on HW_RT_CAS
	default y
	help
	  Check and migrate the RT process to a more suitable
	  CPU in the tick.

endmenu
```
